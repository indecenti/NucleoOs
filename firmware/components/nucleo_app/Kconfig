## firmware/components/nucleo_app/Kconfig
```kconfig
menu "NucleoOS apps"

menu "Games that ship from the store"
    comment "Each one left out of the image becomes the native app of the same id in the store (docs/native-apps.md)."
    comment "On by default: these games are installed from the Store (Native C)."

config NUCLEO_STORE_CONSTELLATIONS
    bool "Constellations (stelle): from the store, not in the firmware"
    default y
    help
        Leaves app_constellations.cpp out of the firmware image (about 68 KB). The web Game Center's
        cross-play save endpoint is not available while the game ships from the store.

config NUCLEO_STORE_POKER
    bool "Poker (poker): from the store, not in the firmware"
    default y
    help
        Leaves app_poker.cpp out of the firmware image.

config NUCLEO_STORE_TANKS
    bool "Tanks (tanks): from the store, not in the firmware"
    default y
    help
        Leaves app_tanks.cpp out of the firmware image (about 70 KB).

config NUCLEO_STORE_TANKDUEL
    bool "Tank Duel (tankd): from the store, not in the firmware"
    default y
    help
        Leaves app_tankduel.cpp out of the firmware image (about 47 KB).

config NUCLEO_STORE_BRAWLER
    bool "Brawler (brawler): from the store, not in the firmware"
    default y
    help
        Leaves app_brawler.cpp and brawler_*.cpp out of the firmware image.

config NUCLEO_STORE_PINBALL
    bool "Pinball (pinball): from the store, not in the firmware"
    default y
    help
        Leaves app_pinball.cpp out of the firmware image.

config NUCLEO_STORE_CARDLER
    bool "Cardler (cardler): from the store, not in the firmware"
    default y
    help
        Leaves app_cardler.cpp out of the firmware image.

config NUCLEO_STORE_ORDE
    bool "Orde (orde): from the store, not in the firmware"
    default y
    help
        Leaves app_vs.cpp and vs_sim.c out of the firmware image.

config NUCLEO_STORE_SNAKE
    bool "Snake (snake): from the store, not in the firmware"
    default y
    help
        Leaves app_snake.cpp out of the firmware image.

config NUCLEO_STORE_SLOTS
    bool "Slots (slots): from the store, not in the firmware"
    default y
    help
        Leaves app_slots.cpp out of the firmware image.

config NUCLEO_STORE_REACTOR
    bool "Reactor (reactor): from the store, not in the firmware"
    default y
    help
        Leaves app_reactor.cpp out of the firmware image.

config NUCLEO_STORE_SANDGARDEN
    bool "Garden (giardino): from the store, not in the firmware"
    default y
    help
        Leaves app_sandgarden.cpp out of the firmware image.

config NUCLEO_STORE_PONG
    bool "Pong (pong): from the store, not in the firmware"
    default y
    help
        Leaves app_pong.cpp out of the firmware image.

config NUCLEO_STORE_DICE
    bool "Dice (dice): from the store, not in the firmware"
    default y
    help
        Leaves app_dice.cpp out of the firmware image.

config NUCLEO_STORE_YAHTZEE
    bool "Yahtzee (yahtzee): from the store, not in the firmware"
    default y
    help
        Leaves app_yahtzee.cpp out of the firmware image.

config NUCLEO_STORE_GBEMU
    bool "Game Boy (gbemu): from the store, not in the firmware"
    default y
    help
        Leaves the Game Boy entry, and with it the Peanut-GB core (nucleo_gb.c), out of the firmware image.
        app_gbemu.cpp is left out only when the Game Gear ships from the store too.

config NUCLEO_STORE_GGEMU
    bool "Game Gear (ggemu): from the store, not in the firmware"
    default y
    help
        Leaves the Game Gear entry, and with it the Z80 machine (nucleo_gg.c), out of the firmware image.

endmenu

endmenu
```

## tools/emu-host/qemu-bench/sdkconfig.defaults
```kconfig
CONFIG_IDF_TARGET="esp32s3"
CONFIG_ESP_DEFAULT_CPU_FREQ_MHZ_240=y
CONFIG_ESPTOOLPY_FLASHSIZE_8MB=y
CONFIG_ESPTOOLPY_FLASHMODE_DIO=y
CONFIG_PARTITION_TABLE_CUSTOM=y
CONFIG_PARTITION_TABLE_CUSTOM_FILENAME="partitions.csv"
CONFIG_COMPILER_OPTIMIZATION_SIZE=y
CONFIG_ESP_TASK_WDT_EN=n
CONFIG_ESP_INT_WDT=n
CONFIG_ESP_MAIN_TASK_STACK_SIZE=16384
CONFIG_ESP32S3_INSTRUCTION_CACHE_16KB=y
CONFIG_ESP32S3_DATA_CACHE_32KB=y
```
