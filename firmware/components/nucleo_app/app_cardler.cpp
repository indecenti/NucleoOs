// app_cardler.cpp — "Cardler": a top-down RPG built on the SAME sandbox as Orde (app_vs).
// Reuses the engine: an SD raw atlas with an exact magenta colour-key + a per-pixel key-skip blitter,
// a camera over a tile world, held-key + tilt movement. The atlas is 8bpp RGB332 to MATCH the device
// canvas (also 8bpp): half the RAM of RGB565 and a straight-copy blit instead of a per-pixel convert.
//
// The WORLD is fully generated by assets/cardler/worldgen.mjs into cardler_world.h — TWO tile layers:
// BASE (opaque terrain) + OVR (transparent props drawn keyed on top), per-ASCII lookup tables, and an
// ENT[] table (NPCs + roaming beasts). Props keep whatever terrain is under them (no baked-in green).
//
// UI/controls mirror Orde: a MENU -> SETTINGS/PLAY state machine, a tilt controller (ADV IMU) that is
// COMPLEMENTARY to the keyboard, and readable large-font menus. RAM: runs under NX_SOLO on a fresh heap;
// the atlas (~21 KB @ 8bpp) is heap-on-enter, freed on exit — no .bss.
#include "nucleo_app.h"
#include "nucleo_kbd.h"
#include "launcher_theme.h"      // W H HINT BG FG C_*
#include "app_gfx.h"             // 'd' = canvas
#include "nucleo_exclusive.h"    // NX_SOLO
#include "esp_timer.h"
#include "cardler_world.h"       // enum C_*, MAP_W/H, BASE[]/OVR[], TIDb/SOLb/TIDo/SOLo/FLPo[128], ENT[]/NENT
#include "tile_blit.h"           // shared blit_op/blit_key/blit_sz (8bpp RGB332), also used by Orde
#include "nucleo_imu.h"          // ADV tilt sensor (complementary control)
#include <M5GFX.h>
#include <stdlib.h>
#include <stdio.h>
#include <string.h>
#include <math.h>

#define ATLAS_PATH "/sd/data/Cardler/atlas.bin"   // raw 8bpp RGB332, C_N x (16x16), magenta key
#define CFG_PATH   "/sd/data/Cardler/settings.json"
#define FPS30_US 33333

// ---- game state machine ----
enum { GS_MENU, GS_SETTINGS, GS_PLAY };
static int s_gs = GS_MENU;
static int s_menu_sel = 0;                   // 0 = Gioca, 1 = Impostazioni

// ---- tilt controller settings (persisted to SD, same scheme as Orde) ----
static int s_tilt_on = 1, s_sens = 10, s_inv_x = 1, s_inv_y = 0;
enum { SET_SENSOR, SET_SENS, SET_INVX, SET_INVY, SET_COUNT };
static int s_set_sel = 0;
static bool  s_tilt_recenter = true;
static int   s_rc_settle = 0;
static float s_roll0 = 0.0f, s_pitch0 = 0.0f;

static void save_settings(void)
{
    FILE *f = fopen(CFG_PATH, "wb"); if (!f) return;
    fprintf(f, "{\"tilt\":%d,\"sens\":%d,\"ix\":%d,\"iy\":%d}\n", s_tilt_on, s_sens, s_inv_x, s_inv_y);
    fclose(f);
}
static void load_settings(void)
{
    FILE *f = fopen(CFG_PATH, "rb"); if (!f) return;
    char b[128]; int n = (int)fread(b, 1, sizeof b - 1, f); fclose(f); if (n < 0) n = 0; b[n] = 0;
    int t = 1, se = 10, ix = 1, iy = 0;
    sscanf(b, "{\"tilt\":%d,\"sens\":%d,\"ix\":%d,\"iy\":%d}", &t, &se, &ix, &iy);
    s_tilt_on = t ? 1 : 0; s_sens = se < 1 ? 1 : (se > 20 ? 20 : se);
    s_inv_x = ix ? 1 : 0; s_inv_y = iy ? 1 : 0;
}

// ---- world / player state ----
static uint8_t (*s_tiles)[256] = nullptr;
static bool     s_atlas_ok = false;
static int      s_px, s_py;                 // player centre, world pixels
static float    s_vx = 0, s_vy = 0, s_accx = 0, s_accy = 0;   // velocity + sub-pixel accumulator
static int      s_fdx = 0, s_fdy = 1;       // facing (last move dir) — used by interact()
static int      s_face = 0;                 // 0 right, 1 left (sprite mirror)
static int      s_hp = 10, s_hpmax = 10, s_gold = 0;
static int      s_hurt = 0;
static int64_t  s_last_us = 0;
static const char *s_dlg = nullptr;
static char     s_toast[40]; static int s_toast_t = 0;
static uint32_t s_frame = 0;

static uint16_t s_open[32]; static int s_nopen = 0;
static inline uint16_t ckey(int tx, int ty) { return (uint16_t)((tx << 8) | (ty & 0xFF)); }
static bool is_open(int tx, int ty) { for (int i = 0; i < s_nopen; i++) if (s_open[i] == ckey(tx, ty)) return true; return false; }

// ---- wandering entities (NPCs + beasts), seeded from ENT[] ----
typedef struct { int x, y; int lo, hi; int8_t vx, vy; int face; uint8_t sprite, kind; const char *line;
                 int pause; } Ent;
static Ent s_ent[NENT];

static void ent_init(void)
{
    for (int i = 0; i < NENT; i++) {
        const CardlerEnt *e = &ENT[i];
        int cx = e->tx * 16 + 8, cy = e->ty * 16 + 8;
        Ent *n = &s_ent[i];
        n->x = cx; n->y = cy; n->face = 0; n->sprite = e->sprite; n->kind = e->kind; n->line = e->line; n->pause = 0;
        if (e->axis) { n->vx = 0; n->vy = 1; n->lo = cy - 8; n->hi = cy + e->span * 16; }
        else         { n->vx = 1; n->vy = 0; n->lo = cx - 8; n->hi = cx + e->span * 16; }
    }
}
static void ent_update(uint32_t frame)
{
    if (!(frame & 1)) return;                         // half-speed pacing
    for (int i = 0; i < NENT; i++) {
        Ent *n = &s_ent[i];
        if (n->pause > 0) { n->pause--; continue; }    // NPCs pause a beat at each turn — feels alive
        n->x += n->vx; n->y += n->vy;
        if (n->vx) { if (n->x < n->lo || n->x > n->hi) { n->vx = -n->vx; n->face = n->vx < 0; n->pause = n->kind ? 0 : 14; } }
        if (n->vy) { if (n->y < n->lo || n->y > n->hi) { n->vy = -n->vy; n->pause = n->kind ? 0 : 14; } }
    }
}
static int ent_at(int x, int y)
{
    for (int i = 0; i < NENT; i++) { int dx = x - s_ent[i].x, dy = y - s_ent[i].y; if (dx > -9 && dx < 9 && dy > -9 && dy < 9) return i; }
    return -1;
}

static bool poll_fn(void);
static bool on_back(int key);

// ---- tiles (two layers: BASE terrain + OVR props) ----
static inline char base_at(int tx, int ty) { return (tx < 0 || tx >= MAP_W || ty < 0 || ty >= MAP_H) ? 0 : BASE[ty][tx]; }
static inline char ovr_at(int tx, int ty)  { return (tx < 0 || tx >= MAP_W || ty < 0 || ty >= MAP_H) ? ' ' : OVR[ty][tx]; }
static inline bool solid_tile(int tx, int ty)
{
    char b = base_at(tx, ty); if (b == 0) return true;
    if (SOLb[(uint8_t)b]) return true;
    char o = ovr_at(tx, ty); return o != ' ' && SOLo[(uint8_t)o] != 0;
}

// ---- atlas blitters ----
static inline void blit_op(int idx, int x, int y) { tile_blit_op(s_tiles, idx, x, y); }
static inline void blit_key(int idx, int x, int y, int fl = 0) { tile_blit_key(s_tiles, idx, x, y, fl); }
static inline void blit_sz(int idx, int f, int cx, int cy, int D) { tile_blit_sz(s_tiles, idx, f, cx, cy, D); }

static void load_atlas(void)
{
    s_atlas_ok = false;
    if (!s_tiles) return;
    FILE *f = fopen(ATLAS_PATH, "rb");
    if (!f) return;
    size_t want = (size_t)C_N * 256;
    s_atlas_ok = (fread(s_tiles, 1, want, f) == want);
    fclose(f);
}

static void find_start(void)
{
    for (int ty = 0; ty < MAP_H; ty++)
        for (int tx = 0; tx < MAP_W; tx++)
            if (BASE[ty][tx] == '@') { s_px = tx * 16 + 8; s_py = ty * 16 + 8; return; }
    s_px = MAP_W * 8; s_py = MAP_H * 8;
}

static void reset_run(void)
{
    find_start(); ent_init();
    s_hp = s_hpmax; s_gold = 0; s_hurt = 0; s_dlg = nullptr; s_toast_t = 0; s_nopen = 0;
    s_fdx = 0; s_fdy = 1; s_face = 0; s_vx = s_vy = s_accx = s_accy = 0;
    s_tilt_recenter = true;
}

static void on_enter(void)
{
    nucleo_app_set_fullscreen(true);
    if (!s_tiles) s_tiles = (uint8_t (*)[256])calloc(C_N, 256);
    load_atlas();
    load_settings();
    reset_run();
    s_gs = GS_MENU; s_menu_sel = 0; s_last_us = 0; s_frame = 0;
    nucleo_app_set_poll_handler(poll_fn);
    nucleo_app_set_back_handler(on_back);
    nucleo_app_set_hint(";/. scegli   Invio: ok   esc: indietro");
    nucleo_app_request_draw();
}

static void on_exit(void)
{
    nucleo_app_set_fullscreen(false);
    free(s_tiles); s_tiles = nullptr; s_atlas_ok = false;
}

// ---- movement + collision ----
static bool solid_px(int x, int y) { return solid_tile(x / 16, y / 16); }
static bool blocked(int cx, int cy)
{
    const int HX = 6, TOP = 1, BOT = 9;
    return solid_px(cx - HX, cy + TOP) || solid_px(cx + HX, cy + TOP) ||
           solid_px(cx - HX, cy + BOT) || solid_px(cx + HX, cy + BOT);
}
static bool ent_blocked(int x, int y) { int i = ent_at(x, y); return i >= 0 && s_ent[i].kind == 0; }

static void toast(const char *m) { strncpy(s_toast, m, sizeof s_toast - 1); s_toast[sizeof s_toast - 1] = 0; s_toast_t = 45; }

static void interact(void)
{
    if (s_dlg) { s_dlg = nullptr; return; }
    int fx = s_px + s_fdx * 14, fy = s_py + s_fdy * 14;
    int e = ent_at(fx, fy);
    if (e >= 0) { s_dlg = s_ent[e].line; return; }
    int tx = fx / 16, ty = fy / 16;
    uint8_t oc = (uint8_t)ovr_at(tx, ty);
    if (oc != ' ' && TIDo[oc] == C_CHEST && !is_open(tx, ty)) {
        if (s_nopen < 32) s_open[s_nopen++] = ckey(tx, ty);
        int g = 5 + (int)(esp_timer_get_time() % 16); s_gold += g;
        char m[32]; snprintf(m, sizeof m, "Scrigno! +%d oro", g); toast(m);
    }
}

// step the player along one axis by `v` px, honouring wall + NPC collision (sub-pixel accumulated).
static void move_axis(float v, float *acc, int axis)
{
    *acc += v; int n = (int)*acc; *acc -= n;
    int step = n > 0 ? 1 : -1;
    for (; n != 0; n -= step) {
        int nx = s_px + (axis == 0 ? step : 0), ny = s_py + (axis == 1 ? step : 0);
        if (!blocked(nx, ny) && !ent_blocked(nx, ny)) { s_px = nx; s_py = ny; }
        else { *acc = 0; break; }
    }
}

static void read_move(void)
{
    if (s_dlg) return;
    const float WALK = 2.0f;
    float tvx = 0, tvy = 0; bool key = false;
    if (nucleo_kbd_char_down('w') || nucleo_kbd_char_down('e') || nucleo_kbd_char_down(';')) { tvy -= WALK; key = true; }
    if (nucleo_kbd_char_down('a') || nucleo_kbd_char_down('s') || nucleo_kbd_char_down('.')) { tvy += WALK; key = true; }
    if (nucleo_kbd_char_down('i') || nucleo_kbd_char_down(',')) { tvx -= WALK; key = true; }
    if (nucleo_kbd_char_down('o') || nucleo_kbd_char_down('/')) { tvx += WALK; key = true; }

    // recenter the tilt neutral (rising edge) — Ctrl / Space / C, same as Orde
    static bool s_rc_prev = false;
    bool rc = ((nucleo_kbd_mods() & NK_MOD_CTRL) != 0) || nucleo_kbd_char_down(' ') || nucleo_kbd_char_down('c');
    if (rc && !s_rc_prev) { s_tilt_recenter = true; }
    s_rc_prev = rc;

    if (key) {
        if (tvx && tvy) { tvx *= 0.707f; tvy *= 0.707f; }
    } else if (s_tilt_on) {
        float gx, gy, gz;
        if (nucleo_imu_present() && nucleo_imu_gravity_screen(&gx, &gy, &gz)) {
            float roll = atan2f(gx, gz), pitch = atan2f(gy, gz);
            if (s_tilt_recenter) { s_roll0 = roll; s_pitch0 = pitch; s_rc_settle = 8; s_tilt_recenter = false; }
            float dr = roll - s_roll0, dp = pitch - s_pitch0;
            if (dr > (float)M_PI) dr -= 2 * (float)M_PI; else if (dr < -(float)M_PI) dr += 2 * (float)M_PI;
            if (dp > (float)M_PI) dp -= 2 * (float)M_PI; else if (dp < -(float)M_PI) dp += 2 * (float)M_PI;
            const float SPAN = 0.60f;
            float DZ = fmaxf(0.015f, 0.16f - (float)s_sens * 0.007f);
            float maxv = 0.8f + (float)s_sens * 0.14f;                     // px/frame at full tilt
            if (s_rc_settle > 0) { s_roll0 += dr * 0.6f; s_pitch0 += dp * 0.6f; s_rc_settle--; dr = 0; dp = 0; }
            else if (fabsf(dr) < DZ && fabsf(dp) < DZ) { s_roll0 += dr * 0.05f; s_pitch0 += dp * 0.05f; }
            if (s_inv_x) dr = -dr;
            if (s_inv_y) dp = -dp;
            float mx = fabsf(dr) > DZ ? fminf(fmaxf(dr, -SPAN), SPAN) / SPAN : 0.0f;
            float my = fabsf(dp) > DZ ? fminf(fmaxf(dp, -SPAN), SPAN) / SPAN : 0.0f;
            tvx = mx * maxv; tvy = my * maxv;
        }
    }
    // ease toward the target velocity, then move with collision (sub-pixel accumulated)
    s_vx += (tvx - s_vx) * 0.4f; s_vy += (tvy - s_vy) * 0.4f;
    if (fabsf(s_vx) > 0.05f || fabsf(s_vy) > 0.05f) {
        float ax = fabsf(s_vx), ay = fabsf(s_vy);
        if (ax > 0.15f || ay > 0.15f) {                                   // update facing while moving
            if (ax >= ay) { s_fdx = s_vx < 0 ? -1 : 1; s_fdy = 0; s_face = s_vx < 0; }
            else          { s_fdy = s_vy < 0 ? -1 : 1; s_fdx = 0; }
        }
    }
    move_axis(s_vx, &s_accx, 0);
    move_axis(s_vy, &s_accy, 1);

    if (s_hurt > 0) s_hurt--;
    else { int i = ent_at(s_px, s_py); if (i >= 0 && s_ent[i].kind == 1) { if (s_hp > 0) s_hp--; s_hurt = 30; toast("Ahi!  -1 HP"); } }
}

// ---- draw helpers ----
static bool s_moving = false;
// soft drop shadow ellipse under an entity, for grounding + depth
static void shadow(int cx, int cy, int r) { d.fillEllipse(cx, cy, r, r / 2 + 1, 0x2124); }

static void draw_dialogue(void)
{
    int y = H - 42;
    d.fillRoundRect(6, y, W - 12, 38, 6, 0x0000);
    d.drawRoundRect(6, y, W - 12, 38, 6, 0xFFFF);
    d.drawRoundRect(7, y + 1, W - 14, 36, 6, 0x3FE6);
    d.setFont(&fonts::Font2); d.setTextColor(0xFFFF); d.setTextSize(1);
    const char *s = s_dlg; char line[40]; int ly = y + 5;
    while (*s) {
        int n = 0; while (s[n] && s[n] != '\n' && n < 30) n++;
        memcpy(line, s, n); line[n] = 0;
        d.setCursor(12, ly); d.print(line);
        ly += 15; s += n; if (*s == '\n') s++;
        if (ly > y + 30) break;
    }
    d.setFont(&fonts::Font0); d.setTextColor(0x8C71);
    d.setCursor(W - 60, y + 30); d.print("Invio: ok");
}

static void draw_hud(void)
{
    // top bar: heart pips for HP (readable at a glance) + a gold coin counter
    d.fillRect(0, 0, W, 14, 0x0000);
    d.drawFastHLine(0, 14, W, 0x2965);
    int hearts = s_hpmax > 12 ? 12 : s_hpmax;
    for (int i = 0; i < hearts; i++) {
        int hx = 4 + i * 9, hy = 4;
        uint16_t c = (i < s_hp) ? (s_hp <= 2 && (s_frame & 8) ? 0xFFFF : 0xF80A) : 0x39C7;
        d.fillRect(hx + 1, hy, 2, 2, c); d.fillRect(hx + 4, hy, 2, 2, c);          // two humps
        d.fillRect(hx, hy + 1, 7, 3, c); d.fillRect(hx + 1, hy + 4, 5, 1, c); d.fillRect(hx + 2, hy + 5, 3, 1, c);
    }
    d.setFont(&fonts::Font2); d.setTextSize(1);
    char b[20]; snprintf(b, sizeof b, "%d", s_gold);
    int gw = (int)d.textWidth(b);
    d.fillCircle(W - gw - 16, 7, 4, 0x8400); d.fillCircle(W - gw - 16, 7, 3, 0xFEA0);   // coin
    d.setTextColor(0x0000); d.setCursor(W - gw - 5, 2); d.print(b);
    d.setTextColor(0xFEA0); d.setCursor(W - gw - 6, 1); d.print(b);
    d.setFont(&fonts::Font0);
}

static void draw_menu(void)
{
    // ---- animated title scene using the whole upper band (dusk sky over a silhouetted land) ----
    const int SKY = 74;                                          // scene height
    for (int y = 0; y < SKY; y++) {                              // dusk gradient: deep indigo -> violet
        float t = (float)y / SKY;
        uint16_t c = (uint16_t)(((int)(2 + 8 * t) << 11) | ((int)(1 + 3 * t) << 5) | (int)(8 + 8 * t));
        d.drawFastHLine(0, y, W, c);
    }
    // twinkling stars (deterministic positions, phase off the frame)
    for (int i = 0; i < 26; i++) {
        int sx = (i * 43 + 7) % W, sy = (i * 29 + 3) % (SKY - 20);
        if (((s_frame >> 3) + i) & 3) d.drawPixel(sx, sy, (i & 1) ? 0xCE7F : 0x9CD3);
    }
    // moon, upper-left, with a soft halo
    d.fillCircle(30, 18, 11, 0x2208); d.fillCircle(30, 18, 9, 0xFFF6); d.fillCircle(34, 15, 6, 0xEF3B);
    // distant castle silhouette on the horizon (right)
    uint16_t sil = 0x18C3;
    d.fillRect(W - 66, SKY - 22, 44, 22, sil);
    for (int k = 0; k < 5; k++) d.fillRect(W - 66 + k * 10, SKY - 26, 5, 5, sil);   // battlements
    d.fillRect(W - 58, SKY - 30, 6, 10, sil); d.fillRect(W - 34, SKY - 30, 6, 10, sil);   // towers
    // rolling hill + a couple of tree silhouettes
    d.fillRect(0, SKY - 10, W, 10, 0x0A21);
    for (int k = 0; k < 4; k++) { int tx = 12 + k * 26; d.fillTriangle(tx, SKY - 10, tx - 5, SKY - 1, tx + 5, SKY - 1, 0x0A21); }
    // a drifting ghost sprite crossing the sky (theme nod to the haunted zone)
    if (s_atlas_ok) { int gx = 10 + (int)((s_frame >> 1) % (W + 20)); blit_sz(C_GHOST, 0, gx - 10, 30 + ((s_frame >> 3) & 3), 20); }

    // ---- foreground panel: title + mascot + menu ----
    d.fillRect(0, SKY, W, H - SKY, 0x0000);
    d.drawFastHLine(0, SKY, W, 0x3FE6);
    // mascot hero standing on the ground line, left of the title
    if (s_atlas_ok) blit_sz(C_HERO, 0, 34, SKY + 16, 34);
    d.setFont(&fonts::Font4);
    d.setTextColor(0x0000); d.setCursor(60 + 1, SKY + 7 + 1); d.print("CARDLER");
    d.setTextColor(0x5FFB); d.setCursor(60,     SKY + 7);     d.print("CARDLER");
    d.setFont(&fonts::Font0); d.setTextColor(0x8C71); d.setCursor(62, SKY + 25); d.print("un mini-RPG per Cardputer");

    const char *items[2] = { "GIOCA", "IMPOSTAZIONI" };
    for (int i = 0; i < 2; i++) {
        int y = SKY + 36 + i * 19, sel = (i == s_menu_sel);
        if (sel) { d.fillRoundRect(36, y - 2, W - 72, 17, 4, 0x2A6A); d.drawRoundRect(36, y - 2, W - 72, 17, 4, 0x3FE6); }
        d.setFont(&fonts::Font2); d.setTextColor(sel ? 0xFFFF : 0x8C71);
        d.setCursor(W / 2 - (int)d.textWidth(items[i]) / 2, y); d.print(items[i]);
    }
    d.setFont(&fonts::Font0);
}

static void draw_settings(void)
{
    d.fillScreen(0x0000);
    d.drawRoundRect(6, 4, W - 12, H - 8, 8, 0x2124);
    d.setFont(&fonts::Font2); d.setTextColor(0x3FE6);
    const char *t = "IMPOSTAZIONI";
    d.setCursor(W / 2 - (int)d.textWidth(t) / 2, 8); d.print(t);

    bool imu = nucleo_imu_present();
    const char *lbl[SET_COUNT] = { "Giroscopio", "Sensibilita", "Inverti X", "Inverti Y" };
    char vbuf[8];
    for (int i = 0; i < SET_COUNT; i++) {
        int y = 30 + i * 20, sel = (i == s_set_sel);
        if (sel) { d.fillRoundRect(16, y, W - 32, 18, 4, 0x2A6A); d.drawRoundRect(16, y, W - 32, 18, 4, 0x3FE6); }
        d.setFont(&fonts::Font2); d.setTextColor(sel ? 0xFFFF : 0x9CD3);
        d.setCursor(22, y + 2); d.print(lbl[i]);
        const char *v = vbuf; uint16_t vc = 0x3FE6;
        if (i == SET_SENSOR)    { v = !imu ? "N/D" : (s_tilt_on ? "ON" : "OFF"); vc = !imu ? 0x8C71 : (s_tilt_on ? 0x3FE6 : 0xF9A6); }
        else if (i == SET_SENS) { snprintf(vbuf, sizeof vbuf, "%d", s_sens); vc = 0xFEA0; }
        else if (i == SET_INVX) { v = s_inv_x ? "SI" : "NO"; }
        else                    { v = s_inv_y ? "SI" : "NO"; }
        d.setTextColor(vc); d.setCursor(W - 24 - (int)d.textWidth(v), y + 2); d.print(v);
    }
    d.setFont(&fonts::Font0); d.setTextColor(0x8C71);
    const char *dsc = imu ? "inclina per muovere - Spazio/C azzera lo zero" : "IMU assente (Cardputer non-ADV)";
    d.setCursor(W / 2 - (int)strlen(dsc) * 3, 116); d.print(dsc);
    d.setTextColor(0x6B4D); const char *h = ";/. voce   ,/. cambia   esc indietro";
    d.setCursor(W / 2 - (int)strlen(h) * 3, 127); d.print(h);
    d.setFont(&fonts::Font0);
}

static void adjust_setting(int dir)
{
    switch (s_set_sel) {
        case SET_SENSOR: s_tilt_on = !s_tilt_on; break;
        case SET_SENS:   s_sens += dir; if (s_sens < 1) s_sens = 1; if (s_sens > 20) s_sens = 20; break;
        case SET_INVX:   s_inv_x = !s_inv_x; break;
        case SET_INVY:   s_inv_y = !s_inv_y; break;
    }
    save_settings();
}

static void draw_world(void)
{
    int cam_x = s_px - W / 2, cam_y = s_py - H / 2;
    int maxx = MAP_W * 16 - W, maxy = MAP_H * 16 - H;
    if (cam_x < 0) cam_x = 0;
    if (cam_x > maxx) cam_x = maxx;
    if (cam_y < 0) cam_y = 0;
    if (cam_y > maxy) cam_y = maxy;

    // ground BASE + keyed OVR prop (two layers; a prop keeps whatever terrain is under it). Torch flames
    // ('f') get a flickering warm glow drawn under them.
    int t0x = cam_x / 16, t0y = cam_y / 16;
    for (int ty = t0y; ty <= t0y + H / 16 + 1 && ty < MAP_H; ty++)
        for (int tx = t0x; tx <= t0x + W / 16 + 1 && tx < MAP_W; tx++) {
            uint8_t b = (uint8_t)BASE[ty][tx], o = (uint8_t)OVR[ty][tx];
            int px = tx * 16 - cam_x, py = ty * 16 - cam_y;
            blit_op(TIDb[b], px, py);
            if (o == ' ') continue;
            if (TIDo[o] == C_CHEST && is_open(tx, ty)) continue;
            if (o == 'f') {                                   // torch: warm flickering pool of light
                int gx = px + 8, gy = py + 9, fl = (int)(((s_frame >> 2) + tx * 5 + ty) & 3);
                d.fillCircle(gx, gy, 8 + fl, 0x4180);         // dim outer warmth
                d.fillCircle(gx, gy, 4 + (fl >> 1), 0x8280);  // brighter core glow
            }
            if (TIDo[o] != 255) blit_key(TIDo[o], px, py, FLPo[o]);
        }

    // entities: shadow + bob + face. NPCs 24, beasts 22, small fauna (kind 2) 16.
    for (int i = 0; i < NENT; i++) {
        int nsx = s_ent[i].x - cam_x, nsy = s_ent[i].y - cam_y;
        if (nsx < -24 || nsx > W + 24 || nsy < -24 || nsy > H + 24) continue;
        bool walking = s_ent[i].pause == 0;
        int nb = walking ? (int)((s_frame >> 3) & 1) : 0;
        int sz = s_ent[i].kind == 0 ? 24 : (s_ent[i].kind == 2 ? 16 : 22);
        shadow(nsx, nsy + sz / 2 - 2, sz / 2 - 2);
        blit_sz(s_ent[i].sprite, s_ent[i].face, nsx, nsy - nb, sz);
    }

    // player: shadow + 26 px sprite + walk bob; blink during i-frames
    int bob = s_moving ? (int)((s_frame >> 2) & 1) * 2 : 0;
    int psx = s_px - cam_x, psy = s_py - cam_y;
    shadow(psx, psy + 11, 11);
    if (!(s_hurt > 0 && (s_frame & 4))) blit_sz(C_HERO, s_face, psx, psy - bob, 26);
}

// Spectral overlay for the haunted graveyard: drifting fog scanlines + pale spirits rising. Drawn only
// while the player stands on crypt ground, so the mood is a place, not a permanent filter.
static void haunt_overlay(void)
{
    for (int y = 15 + (int)((s_frame >> 1) % 7); y < H; y += 7)     // slow-drifting cold fog bands (below HUD)
        d.drawFastHLine(0, y, W, 0x28A6);
    for (int i = 0; i < 7; i++) {                                   // rising spirits
        int phase = (int)((s_frame >> 1) + i * 53);
        int sy = H - (phase % (H + 30));
        int sx = (i * 41 + 20) % (W - 20) + 10 + (((phase >> 3) & 7) - 3);
        if (sy > 15 && sy < H) {
            d.fillCircle(sx, sy, 2, 0xBEFF);                        // spirit body (pale blue-white)
            d.drawPixel(sx, sy + 3, 0x6CBF); d.drawPixel(sx, sy + 5, 0x4438);   // faint tail
        }
    }
}

static void on_draw(void)
{
    if (!s_tiles) { d.fillScreen(0x0000); return; }
    s_frame++;                                          // advance always, so menus can animate too
    if (s_gs == GS_MENU)     { draw_menu();     return; }
    if (s_gs == GS_SETTINGS) { draw_settings(); return; }

    read_move();
    ent_update(s_frame);
    if (s_toast_t > 0) s_toast_t--;
    s_moving = (fabsf(s_vx) > 0.15f || fabsf(s_vy) > 0.15f);

    draw_world();
    char gb = base_at(s_px / 16, s_py / 16);
    if (gb == 'g' || gb == 'G') haunt_overlay();       // in the graveyard -> spectral mood
    draw_hud();

    if (s_toast_t > 0) {
        int tw = (int)strlen(s_toast) * 6;
        d.fillRoundRect(W / 2 - tw / 2 - 6, 18, tw + 12, 14, 4, 0x0000);
        d.drawRoundRect(W / 2 - tw / 2 - 6, 18, tw + 12, 14, 4, 0xFEA0);
        d.setTextColor(0xFEA0); d.setCursor(W / 2 - tw / 2, 21); d.print(s_toast);
    }
    if (s_dlg) draw_dialogue();
}

static bool poll_fn(void)
{
    int64_t now = esp_timer_get_time();
    if (now - s_last_us < FPS30_US) return false;
    s_last_us = now;
    return true;
}

static bool on_back(int key)
{
    if (key == NK_LEFT) {                               // LEFT: navigate menus; swallow in play
        if (s_gs == GS_SETTINGS) { adjust_setting(-1); nucleo_app_request_draw(); return true; }
        return true;
    }
    if (key == NK_BACK) {
        if (s_gs == GS_PLAY || s_gs == GS_SETTINGS) { s_gs = GS_MENU; nucleo_app_request_draw(); return true; }
        return false;                                  // BACK from the menu closes the app
    }
    return false;
}

static void on_key(int key, char ch)
{
    (void)ch;
    switch (s_gs) {
        case GS_MENU:
            if (key == NK_UP || key == NK_DOWN || ch == 'e' || ch == 's') { s_menu_sel ^= 1; }
            else if (key == NK_ENTER) {
                if (s_menu_sel == 0) { reset_run(); s_gs = GS_PLAY; nucleo_app_set_hint("W/A/S/D o INCLINA muovi   Invio parla/apri   Spazio azzera   esc menu"); }
                else { s_set_sel = 0; s_gs = GS_SETTINGS; }
            }
            break;
        case GS_SETTINGS:
            if (key == NK_UP || ch == 'e')        s_set_sel = (s_set_sel + SET_COUNT - 1) % SET_COUNT;
            else if (key == NK_DOWN || ch == 's') s_set_sel = (s_set_sel + 1) % SET_COUNT;
            else if (key == NK_RIGHT || ch == 'd') adjust_setting(+1);
            else if (key == NK_ENTER)             adjust_setting(+1);
            break;
        case GS_PLAY:
            if (key == NK_ENTER) interact();
            break;
    }
    nucleo_app_request_draw();
}

extern "C" void nucleo_register_cardler(void)
{
    static const nucleo_app_def_t app = {
        "cardler", "Cardler", "Games", "Mini RPG: esplora, parla, raccogli",
        'C', 0x3FE6,
        on_enter, on_key, nullptr, on_draw, on_exit,
        NX_SOLO
    };
    nucleo_app_register(&app);
}
