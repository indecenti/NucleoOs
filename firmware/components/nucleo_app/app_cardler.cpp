// app_cardler.cpp — "Cardler": a top-down mini-RPG on the SAME tile sandbox as Orde (app_vs): an SD raw
// 8bpp RGB332 atlas with an exact magenta key (tile_blit.h, which matches the device canvas and blits
// straight into it), a camera over a tile world, held-key + tilt movement.
//
// The WORLD is generated by assets/cardler/worldgen.mjs into cardler_world.h — TWO run-length tile layers:
// BASE (opaque terrain) + OVR (transparent props drawn keyed on top), per-ASCII lookup tables, and an ENT[]
// table (NPCs, beasts, rats). Props keep whatever terrain is under them. A row is decoded on the stack
// when it is drawn (rle_row) and single tiles are looked up for collision (rle_at).
//
// The game: find every chest in the kingdom. Beasts and spirits bite on contact (and knock you back),
// talking to a villager restores your HP, fainting wakes you at the village with half your gold. Progress
// (position, HP, gold, opened chests) is saved to SD on leaving play; a save that does not read back
// intact is never overwritten except by an explicit "New game".
//
// Look: the shared console kit (game_ui.h) for title, menus and cards; in play, outlined sprites over
// dithered (translucent) shadows and torch light, floating gold / damage numbers, a hit shake.
// Controls mirror Orde: W/E up, A/S down, I left, O right (or the arrows), diagonals with two keys; on the
// ADV a tilt controller is COMPLEMENTARY to the keyboard. Text follows the OS language (game_text.h).
// RAM: NX_SOLO; the atlas (4 KB chunks) is heap-on-enter, the run state is APP_RAM — nothing big in .bss.
#include "nucleo_app.h"
#include "nucleo_kbd.h"
#include "launcher_theme.h"      // W H HINT
#include "app_gfx.h"             // 'd' = canvas
#include "nucleo_exclusive.h"    // NX_SOLO
#include "esp_timer.h"
#include "cardler_world.h"       // enum C_*, MAP_W/H, BASE/OVR (+_ROW), TIDb/SOLb/TIDo/SOLo/FLPo[128], ENT[]/NENT
#include "tile_blit.h"           // shared 8bpp atlas + blitters, also used by Orde
#include "nucleo_imu.h"          // ADV tilt sensor (complementary control)
#include "game_text.h"           // the five OS languages (it/en in flash, es/fr/de from the SD pack)
#include "game_ui.h"             // gui:: the console kit (title, menu, dialog, text)
#include "game_sfx.h"            // shared SFX: the PC-rendered pack, else a tone
#include <M5GFX.h>
#include <stdlib.h>
#include <stdio.h>
#include <string.h>
#include <math.h>
#include <stddef.h>
#include <sys/stat.h>

#define DIRP       "/sd/data/Cardler"
#define ATLAS_PATH DIRP "/atlas.bin"       // raw 8bpp RGB332, C_N x (16x16), magenta key
#define CFG_PATH   DIRP "/settings.json"
#define SAVE_PATH  DIRP "/save.bin"
#define STEP_US    33333                  // 30 Hz game step
#define HPMAX      10
#define MAXCHEST   32
#define NPOP       6                      // floating numbers on screen at once
#define COL_ACC    0x3FE6                 // Cardler green
#define COL_GOLD   0xFEA0
#define COL_MUT    0x9CD3

enum { GS_MENU, GS_SETTINGS, GS_PLAY, GS_PAUSE, GS_OVER, GS_WIN };
static int s_gs = GS_MENU;
static gui::Menu s_menu, s_setm;

// ---- sound: cues rendered on the PC (tools/sfx-gen/games/cardler.py -> /sd/data/Cardler/pack) ----
enum { SFX_SELECT = 1, SFX_START, SFX_STEP, SFX_TALK, SFX_CHEST, SFX_HEAL, SFX_HURT, SFX_FAINT, SFX_WIN, SFX_PAUSE, SFX_N };
static TileCfg s_cfg;                       // sound + tilt settings (tile_blit.h, shared with Orde)
static const char *sfx_name(int id)
{
    static const char *const N[SFX_N] = { "x", "select", "start", "step", "talk", "chest", "heal", "hurt", "faint", "win", "pause" };
    return id > 0 && id < SFX_N ? N[id] : "x";
}
static int sfx_recipe(int id, notify_voice_t *v)   // the tone a cue falls back to without the pack
{
    static const uint16_t HZ[SFX_N] = { 0, 880, 660, 140, 990, 1320, 1170, 200, 160, 1050, 520 };
    notify__voice(&v[0], HZ[id > 0 && id < SFX_N ? id : 1], 0.0f, 0.07f);
    return 1;
}
static bool sfx_important(int id) { return id == SFX_CHEST || id == SFX_HURT || id == SFX_FAINT || id == SFX_WIN || id == SFX_START; }
static const game_sfx_t s_sfx = { DIRP, sfx_name, sfx_recipe, SFX_N - 1, 1, 16000, sfx_important, &s_cfg.audio };
static inline void sfx(int id) { game_sfx_play(&s_sfx, id); }

// ---- run state: the framework's per-app RAM (APP_RAM), 0 B while the game is closed ----
typedef struct { int x, y, lo, hi; int8_t vx, vy; uint8_t face, sprite, kind, line; int pause; } Ent;
typedef struct { int16_t x, y, v; uint8_t t, gold; } Pop;               // a rising "+12" / "-1"
typedef struct { Ent ent[NENT]; uint16_t open[MAXCHEST]; int nopen; Pop pop[NPOP]; char toast[32]; } Run;
static Run *R;

static TileAtlas s_atlas;                   // 4 KB heap chunks while open
static bool     s_atlas_ok = false;
static int      s_px, s_py;                 // player centre, world pixels
static float    s_vx = 0, s_vy = 0, s_accx = 0, s_accy = 0;   // velocity + sub-pixel accumulator
static int      s_fdx = 0, s_fdy = 1;       // facing (last move dir) — used by interact()
static int      s_face = 0;                 // 0 right, 1 left (sprite mirror)
static int      s_hp = HPMAX, s_gold = 0, s_hurt = 0, s_shake = 0;
static int      s_nchest = 0;               // chests in the world (counted once)
static bool     s_won = false;              // every chest found (the run goes on: explore freely)
static int      s_start_x, s_start_y;       // the village spawn ('@')
static int64_t  s_last_us = 0, s_poll_us = 0;
static int      s_dlg = -1;                 // open dialogue: npc_line() index, -1 = none
static int      s_toast_t = 0;
static int      s_legend_t = 0;             // frames left of the controls legend shown when play starts
static uint32_t s_frame = 0;
static bool     s_moving = false;
static bool     s_has_save = false, s_ingame = false;

static inline const uint8_t *T(int i) { return tile_px(&s_atlas, i); }

// NPC / beast lines, indexed by ENT[].line — the order of worldgen.mjs's npc/beast/ghost/rat line lists.
static const char *npc_line(int i)
{
    switch (i) {
        case 0:  return GT("Benvenuto a Cardler! Esplora il villaggio.", "Welcome to Cardler! Explore the village.");
        case 1:  return GT("Il castello nasconde un tesoro, ma occhio ai mostri.", "The castle hides a treasure. Mind the monsters.");
        case 2:  return GT("Compro pelli di lupo. Torna con dell'oro.", "I buy wolf pelts. Come back with gold.");
        case 3:  return GT("Hai visto il mio gatto? Era qui un attimo fa...", "Have you seen my cat? It was here a moment ago...");
        case 4:  return GT("Accendi il faro a est, le orde premono!", "Light the beacon east, the hordes are coming!");
        case 5:  return GT("Riposati, poi parti all'avventura.", "Rest, then set off on your adventure.");
        case 6:  return GT("A sud c'e' un cimitero... non andarci da solo.", "There's a graveyard south... don't go there alone.");
        case 7:  return GT("I ratti rubano il grano, ma sono innocui.", "The rats steal the grain, but they are harmless.");
        case 8:  return GT("Grrr...", "Grrr...");
        case 9:  return GT("Un ringhio nell'ombra.", "A growl in the shadows.");
        case 10: return GT("Sssss...", "Sssss...");
        case 11: return GT("Occhi rossi nel buio.", "Red eyes in the dark.");
        case 12: return GT("Uuuuuh...", "Oooooh...");
        case 13: return GT("Un freddo spettrale ti attraversa.", "A ghostly chill goes through you.");
        case 14: return GT("...riposa con noi...", "...rest with us...");
        case 15: return GT("Ossa e silenzio.", "Bones and silence.");
        case 16: return GT("Squit!", "Squeak!");
        case 17: return GT("*annusa*", "*sniff*");
        default: return GT("Squit squit!", "Squeak squeak!");
    }
}

// ---- world: run-length rows (a byte < 0x80 is a tile char, 0x80|n is n+3 copies of the next byte) ----
static void rle_row(const char *rle, const uint16_t *rows, int ty, char *out)
{
    const uint8_t *p = (const uint8_t *)rle + rows[ty];
    for (int x = 0; x < MAP_W; ) {
        uint8_t b = *p++; int n = 1;
        if (b & 0x80) { n = (b & 0x7F) + 3; b = *p++; }
        while (n-- > 0 && x < MAP_W) out[x++] = (char)b;
    }
}
static char rle_at(const char *rle, const uint16_t *rows, int tx, int ty)
{
    const uint8_t *p = (const uint8_t *)rle + rows[ty];
    for (int x = 0; ; ) {
        uint8_t b = *p++; int n = 1;
        if (b & 0x80) { n = (b & 0x7F) + 3; b = *p++; }
        if ((x += n) > tx) return (char)b;
    }
}
static inline bool in_map(int tx, int ty) { return tx >= 0 && tx < MAP_W && ty >= 0 && ty < MAP_H; }
static inline char base_at(int tx, int ty) { return in_map(tx, ty) ? rle_at(BASE, BASE_ROW, tx, ty) : 0; }
static inline char ovr_at(int tx, int ty)  { return in_map(tx, ty) ? rle_at(OVR, OVR_ROW, tx, ty) : ' '; }
static inline bool is_chest(char o) { return o != ' ' && TIDo[(uint8_t)o] == C_CHEST; }
static bool solid_tile(int tx, int ty)
{
    char b = base_at(tx, ty); if (b == 0 || SOLb[(uint8_t)b]) return true;
    char o = ovr_at(tx, ty); return o != ' ' && SOLo[(uint8_t)o] != 0;
}

static inline uint16_t ckey(int tx, int ty) { return (uint16_t)((tx << 8) | (ty & 0xFF)); }
static bool is_open(int tx, int ty) { for (int i = 0; i < R->nopen; i++) if (R->open[i] == ckey(tx, ty)) return true; return false; }

// One pass over the map at enter: the village spawn and how many chests there are to find.
static void scan_world(void)
{
    char row[MAP_W];
    s_start_x = MAP_W * 8; s_start_y = MAP_H * 8; s_nchest = 0;
    for (int ty = 0; ty < MAP_H; ty++) {
        rle_row(BASE, BASE_ROW, ty, row);
        for (int tx = 0; tx < MAP_W; tx++) if (row[tx] == '@') { s_start_x = tx * 16 + 8; s_start_y = ty * 16 + 8; }
        rle_row(OVR, OVR_ROW, ty, row);
        for (int tx = 0; tx < MAP_W; tx++) if (is_chest(row[tx])) s_nchest++;
    }
    if (s_nchest > MAXCHEST) s_nchest = MAXCHEST;
}

// ---- wandering entities (NPCs + beasts), seeded from ENT[] ----
static void ent_init(void)
{
    for (int i = 0; i < NENT; i++) {
        const CardlerEnt *e = &ENT[i];
        int cx = e->tx * 16 + 8, cy = e->ty * 16 + 8;
        Ent *n = &R->ent[i];
        n->x = cx; n->y = cy; n->face = 0; n->sprite = e->sprite; n->kind = e->kind; n->line = e->line; n->pause = 0;
        if (e->axis) { n->vx = 0; n->vy = 1; n->lo = cy - 8; n->hi = cy + e->span * 16; }
        else         { n->vx = 1; n->vy = 0; n->lo = cx - 8; n->hi = cx + e->span * 16; }
    }
}
static inline bool near_player(int x, int y) { int dx = x - s_px, dy = y - s_py; return dx > -9 && dx < 9 && dy > -9 && dy < 9; }
static void ent_update(void)
{
    if (!(s_frame & 1)) return;                         // half-speed pacing
    for (int i = 0; i < NENT; i++) {
        Ent *n = &R->ent[i];
        if (n->pause > 0) { n->pause--; continue; }    // NPCs pause a beat at each turn — feels alive
        if (n->kind == 0 && near_player(n->x + n->vx, n->y + n->vy)) continue;   // villagers wait, never walk into you
        n->x += n->vx; n->y += n->vy;
        if (n->vx) { if (n->x < n->lo || n->x > n->hi) { n->vx = -n->vx; n->face = n->vx < 0; n->pause = n->kind ? 0 : 14; } }
        if (n->vy) { if (n->y < n->lo || n->y > n->hi) { n->vy = -n->vy; n->pause = n->kind ? 0 : 14; } }
    }
}
static int ent_at(int x, int y)
{
    for (int i = 0; i < NENT; i++) { int dx = x - R->ent[i].x, dy = y - R->ent[i].y; if (dx > -9 && dx < 9 && dy > -9 && dy < 9) return i; }
    return -1;
}

// ---- save: magic + version + checksum; written via a temp file, never over a save that failed to read ----
#define SAVE_MAGIC 0x52444443u   // 'CDDR'
#define SAVE_VER   1
typedef struct { uint32_t magic; uint16_t ver, nopen; int16_t px, py; int32_t gold; uint8_t hp, won, pad[2];
                 uint16_t open[MAXCHEST]; uint32_t sum; } CardlerSave;
static uint32_t save_sum(const CardlerSave *s)
{
    uint32_t h = 2166136261u; const uint8_t *p = (const uint8_t *)s;
    for (size_t i = 0; i < offsetof(CardlerSave, sum); i++) { h ^= p[i]; h *= 16777619u; }
    return h;
}
static bool save_read(CardlerSave *s)
{
    FILE *f = fopen(SAVE_PATH, "rb"); if (!f) return false;
    bool ok = fread(s, sizeof *s, 1, f) == 1 && fgetc(f) == EOF;
    fclose(f);
    return ok && s->magic == SAVE_MAGIC && s->ver == SAVE_VER && s->sum == save_sum(s) && s->nopen <= MAXCHEST &&
           s->hp >= 1 && s->hp <= HPMAX && s->px > 0 && s->px < MAP_W * 16 && s->py > 0 && s->py < MAP_H * 16 && s->gold >= 0;
}
static void save_write(void)
{
    CardlerSave s; memset(&s, 0, sizeof s);
    s.magic = SAVE_MAGIC; s.ver = SAVE_VER; s.nopen = (uint16_t)R->nopen; s.px = (int16_t)s_px; s.py = (int16_t)s_py;
    s.gold = s_gold; s.hp = (uint8_t)(s_hp < 1 ? 1 : s_hp); s.won = s_won;
    memcpy(s.open, R->open, sizeof s.open);
    s.sum = save_sum(&s);
    mkdir(DIRP, 0777);
    FILE *f = fopen(SAVE_PATH ".tmp", "wb"); if (!f) return;
    bool ok = fwrite(&s, sizeof s, 1, f) == 1;
    ok = (fclose(f) == 0) && ok;                       // fclose flushes: a full card fails here
    if (!ok) { remove(SAVE_PATH ".tmp"); return; }
    remove(SAVE_PATH);                                 // FAT rename does not replace
    if (rename(SAVE_PATH ".tmp", SAVE_PATH) == 0) s_has_save = true;
}

static void toast(const char *m) { snprintf(R->toast, sizeof R->toast, "%s", m); s_toast_t = 50; }
static void pop(int x, int y, int v, bool gold)
{
    for (int i = 0; i < NPOP; i++) if (!R->pop[i].t) {
        Pop *p = &R->pop[i]; p->x = (int16_t)x; p->y = (int16_t)y; p->v = (int16_t)v; p->t = 40; p->gold = gold; return;
    }
}

static void new_run(void)
{
    ent_init();
    s_px = s_start_x; s_py = s_start_y;
    s_hp = HPMAX; s_gold = 0; s_won = false; R->nopen = 0;
}
static bool load_run(void)
{
    CardlerSave s;
    if (!save_read(&s)) return false;
    ent_init();
    s_px = s.px; s_py = s.py; s_hp = s.hp; s_gold = s.gold; s_won = s.won;
    R->nopen = s.nopen; memcpy(R->open, s.open, sizeof R->open);
    return true;
}

static bool poll_fn(void);
static bool on_back(int key);

// ---- screen flow: one place sets fullscreen + hint for each state (menus keep the hint bar) ----
static void go(int gs)
{
    s_gs = gs;
    nucleo_app_set_fullscreen(gs >= GS_PLAY);
    switch (gs) {
        case GS_MENU:     nucleo_app_set_hint(GT("SU/GIU  INVIO scegli  Esc esci", "UP/DN  ENTER pick  Esc quit")); break;
        case GS_SETTINGS: nucleo_app_set_hint(GT("SU/GIU  SX/DX cambia  Esc ok", "UP/DN  L/R change  Esc done")); break;
        case GS_PLAY:     nucleo_app_set_hint(GT("Frecce muovi  INVIO parla  Esc pausa", "Arrows move  ENTER talk  Esc pause")); break;
        default: break;
    }
    nucleo_app_request_draw();
}
static void play(void)
{
    s_dlg = -1; s_toast_t = 0; s_hurt = 0; s_shake = 0; s_legend_t = 120;
    s_fdx = 0; s_fdy = 1; s_face = 0; s_vx = s_vy = s_accx = s_accy = 0;
    memset(R->pop, 0, sizeof R->pop);
    s_cfg.recenter = true; s_ingame = true;
    sfx(SFX_START);
    go(GS_PLAY);
}
static void leave_play(void)                           // save the run and return to the title
{
    if (s_ingame) save_write();
    s_ingame = false;
    s_menu.sel = 0; s_menu.pos = 0;
    go(GS_MENU);
}

static void on_enter(void)
{
    game_text_open("cardler");
    s_atlas_ok = tile_atlas_load(&s_atlas, ATLAS_PATH, C_N);
    tile_cfg_load(&s_cfg, CFG_PATH);
    scan_world();
    CardlerSave probe; s_has_save = save_read(&probe);
    new_run();
    s_menu.sel = 0; s_menu.pos = 0; s_last_us = s_poll_us = 0; s_frame = 0; s_ingame = false;
    nucleo_app_set_poll_handler(poll_fn);
    nucleo_app_set_back_handler(on_back);
    go(GS_MENU);
}

static void on_exit(void)
{
    if (s_ingame) save_write();
    tile_cfg_save(&s_cfg, CFG_PATH);
    s_ingame = false;
    nucleo_app_set_fullscreen(false);
    tile_atlas_free(&s_atlas); s_atlas_ok = false;
    game_text_close();
}

// ---- movement + collision ----
static bool solid_px(int x, int y) { return solid_tile(x >> 4, y >> 4); }
static bool blocked(int cx, int cy)
{
    const int HX = 6, TOP = 1, BOT = 9;
    return solid_px(cx - HX, cy + TOP) || solid_px(cx + HX, cy + TOP) ||
           solid_px(cx - HX, cy + BOT) || solid_px(cx + HX, cy + BOT);
}
static bool ent_blocked(int x, int y) { int i = ent_at(x, y); return i >= 0 && R->ent[i].kind == 0; }

// step the player along one axis by `v` px, honouring wall + NPC collision (sub-pixel accumulated).
static void move_axis(float v, float *acc, int axis)
{
    *acc += v; int n = (int)*acc; *acc -= n;
    int step = n > 0 ? 1 : -1;
    for (; n != 0; n -= step) {
        int nx = s_px + (axis == 0 ? step : 0), ny = s_py + (axis == 1 ? step : 0);
        if (!blocked(nx, ny) && !ent_blocked(nx, ny)) { s_px = nx; s_py = ny; }
        else { *acc = 0; break; }
    }
}

static void interact(void)
{
    if (s_dlg >= 0) { s_dlg = -1; return; }
    int fx = s_px + s_fdx * 14, fy = s_py + s_fdy * 14;
    int e = ent_at(fx, fy);
    if (e >= 0) {
        s_dlg = R->ent[e].line;
        if (R->ent[e].kind == 0 && s_hp < HPMAX) { pop(s_px, s_py - 18, HPMAX - s_hp, false); s_hp = HPMAX; toast(GT("Ti senti riposato", "You feel rested")); sfx(SFX_HEAL); }
        else sfx(SFX_TALK);
        return;
    }
    int tx = fx >> 4, ty = fy >> 4;
    if (is_chest(ovr_at(tx, ty)) && !is_open(tx, ty) && R->nopen < MAXCHEST) {
        R->open[R->nopen++] = ckey(tx, ty);
        int g = 10 + (tx * 7 + ty * 13) % 21; s_gold += g;
        pop(tx * 16 + 8, ty * 16, g, true);
        char m[32]; snprintf(m, sizeof m, GT("Scrigno %d di %d", "Chest %d of %d"), R->nopen, s_nchest); toast(m);
        if (!s_won && R->nopen >= s_nchest) { s_won = true; save_write(); sfx(SFX_WIN); go(GS_WIN); }
        else sfx(SFX_CHEST);
    }
}

static void read_move(void)
{
    const float WALK = 2.0f;
    float tvx = 0, tvy = 0; bool key = false;
    if (s_dlg < 0) {
        if (nucleo_kbd_char_down('w') || nucleo_kbd_char_down('e') || nucleo_kbd_char_down(';')) { tvy -= WALK; key = true; }
        if (nucleo_kbd_char_down('a') || nucleo_kbd_char_down('s') || nucleo_kbd_char_down('.')) { tvy += WALK; key = true; }
        if (nucleo_kbd_char_down('i') || nucleo_kbd_char_down(',')) { tvx -= WALK; key = true; }
        if (nucleo_kbd_char_down('o') || nucleo_kbd_char_down('/')) { tvx += WALK; key = true; }
    }
    tile_cfg_recenter_key(&s_cfg);                                       // Ctrl / Space / C, same as Orde
    float mx, my, maxv = 0.8f + (float)s_cfg.sens * 0.14f;               // px/frame at full tilt
    if (key) { if (tvx && tvy) { tvx *= 0.707f; tvy *= 0.707f; } }
    else if (s_dlg < 0 && tile_cfg_tilt(&s_cfg, &mx, &my)) { tvx = mx * maxv; tvy = my * maxv; }
    // ease toward the target velocity, then move with collision (sub-pixel accumulated)
    s_vx += (tvx - s_vx) * 0.4f; s_vy += (tvy - s_vy) * 0.4f;
    float ax = fabsf(s_vx), ay = fabsf(s_vy);
    if (ax > 0.15f || ay > 0.15f) {                                       // update facing while moving
        if (ax >= ay) { s_fdx = s_vx < 0 ? -1 : 1; s_fdy = 0; s_face = s_vx < 0; }
        else          { s_fdy = s_vy < 0 ? -1 : 1; s_fdx = 0; }
    }
    move_axis(s_vx, &s_accx, 0);
    move_axis(s_vy, &s_accy, 1);
    s_moving = ax > 0.15f || ay > 0.15f;
    if (s_moving && key && (s_frame % 14) == 0) sfx(SFX_STEP);           // soft footsteps (dropped while a cue plays)
}

// Beasts and spirits bite on contact: -1 HP, a short invulnerability and a knock-back away from them.
static void contact_damage(void)
{
    if (s_hurt > 0) { s_hurt--; return; }
    int i = ent_at(s_px, s_py);
    if (i < 0 || R->ent[i].kind != 1) return;
    s_hp--; s_hurt = 30; s_shake = 8;
    pop(s_px, s_py - 18, -1, false);
    float kx = (float)(s_px - R->ent[i].x), ky = (float)(s_py - R->ent[i].y);
    if (kx == 0 && ky == 0) ky = 1;
    float k = 10.0f / fmaxf(fabsf(kx), fabsf(ky)), a0 = 0, a1 = 0;
    move_axis(kx * k, &a0, 0); move_axis(ky * k, &a1, 1);
    s_vx = s_vy = 0;
    if (s_hp <= 0) { s_hp = 0; s_dlg = -1; sfx(SFX_FAINT); go(GS_OVER); }
    else sfx(SFX_HURT);
}

// One 30 Hz game step (from the poll handler, so the game speed never depends on how often it is drawn).
static void step(void)
{
    read_move();
    ent_update();
    contact_damage();
    if (s_toast_t > 0) s_toast_t--;
    if (s_legend_t > 0) s_legend_t--;
    if (s_shake > 0) s_shake--;
    for (int i = 0; i < NPOP; i++) if (R->pop[i].t) { R->pop[i].t--; if (R->pop[i].t & 1) R->pop[i].y--; }
}

// ---- draw ----
static void heart(int x, int y, uint16_t c)
{
    d.fillRect(x + 1, y, 2, 2, c); d.fillRect(x + 4, y, 2, 2, c);
    d.fillRect(x, y + 1, 7, 3, c); d.fillRect(x + 1, y + 4, 5, 1, c); d.fillRect(x + 2, y + 5, 3, 1, c);
}

// dialogue box: word-wrapped to the box (Font2), up to 2 lines
static void draw_dialogue(void)
{
    int y = H - 45;
    gui::panel(4, y, W - 10, 42, gui::rgb(0, 0, 36), COL_ACC);
    const char *s = npc_line(s_dlg); char line[48];
    d.setFont(&fonts::Font2); d.setTextSize(1);
    for (int ln = 0, ly = y + 4; ln < 2 && *s; ln++, ly += 17) {
        int n = 0, cut = 0;
        while (s[n] && n < (int)sizeof line - 1) {
            line[n] = s[n]; line[n + 1] = 0;
            if (d.textWidth(line) > W - 26) break;
            if (s[n] == ' ') cut = n;
            n++;
        }
        if (s[n] && cut > 0) n = cut;                    // wrap at the last space that fit
        memcpy(line, s, n); line[n] = 0;
        gui::text(line, 12, ly, 0, gui::F_SMALL, 0xFFFF, 0x0000);
        d.setFont(&fonts::Font2);
        s += n; while (*s == ' ') s++;
    }
    d.setFont(&fonts::Font0);
    if ((s_frame >> 3) & 1) d.fillTriangle(W - 16, y + 31, W - 8, y + 31, W - 12, y + 36, COL_GOLD);   // "more" cue
}

static void draw_hud(void)
{
    // top bar: heart pips for HP, chests found / total, gold — over a dithered dark band
    gui::vgradient(0, 0, W, 16, gui::rgb(0, 0, 0), gui::rgb(0, 36, 36));
    d.drawFastHLine(0, 16, W, gui::rgb(36, 109, 85));
    for (int i = 0; i < HPMAX; i++)
        heart(3 + i * 9, 5, (i < s_hp) ? (s_hp <= 2 && (s_frame & 8) ? 0xFFFF : 0xF80A) : 0x39C7);
    char b[16];
    snprintf(b, sizeof b, "%d", s_gold);
    int gw = gui::text(b, W - 3, 0, 2, gui::F_SMALL, COL_GOLD, 0x0000);
    int cx = W - gw - 12;
    d.fillCircle(cx, 8, 4, 0x8400); d.fillCircle(cx, 8, 3, COL_GOLD); d.drawFastVLine(cx, 7, 3, 0xFFF6);
    snprintf(b, sizeof b, "%d/%d", R->nopen, s_nchest);
    int cw = gui::text(b, cx - 8, 0, 2, gui::F_SMALL, s_won ? COL_ACC : 0xFFFF, 0x0000);
    tile_blit_sz(T(C_CHEST), 0, cx - 17 - cw, 8, 14);
}

static void draw_world(void)
{
    int cam_x = s_px - W / 2, cam_y = s_py - H / 2;
    int maxx = MAP_W * 16 - W, maxy = MAP_H * 16 - H;
    if (cam_x < 0) cam_x = 0;
    if (cam_x > maxx) cam_x = maxx;
    if (cam_y < 0) cam_y = 0;
    if (cam_y > maxy) cam_y = maxy;
    if (s_shake > 0) { cam_x += (s_shake & 2) ? 2 : -2; cam_y += (s_shake & 1) ? 1 : -1; }   // hit shake

    // ground BASE + keyed OVR prop (a prop keeps whatever terrain is under it); one decoded row pair at a
    // time on the stack. Torch flames ('f') throw a flickering, stippled (translucent) pool of warm light.
    int t0x = cam_x >> 4, t0y = cam_y >> 4;
    char brow[MAP_W], orow[MAP_W];
    for (int ty = t0y < 0 ? 0 : t0y; ty <= t0y + H / 16 + 1 && ty < MAP_H; ty++) {
        rle_row(BASE, BASE_ROW, ty, brow); rle_row(OVR, OVR_ROW, ty, orow);
        for (int tx = t0x < 0 ? 0 : t0x; tx <= t0x + W / 16 + 1 && tx < MAP_W; tx++) {
            uint8_t b = (uint8_t)brow[tx], o = (uint8_t)orow[tx];
            int px = tx * 16 - cam_x, py = ty * 16 - cam_y;
            tile_blit_op(T(TIDb[b]), px, py);
            if (o == ' ' || TIDo[o] == 255) continue;
            if (TIDo[o] == C_CHEST && is_open(tx, ty)) continue;
            if (o == 'f') {
                int fl = (int)(((s_frame >> 2) + tx * 5 + ty) & 3);
                tile_dither_ellipse(px + 8, py + 10, 13 + fl, 9 + (fl >> 1), TILE_RGB332(255, 160, 40));
            }
            tile_blit_key(T(TIDo[o]), px, py, FLPo[o]);
        }
    }

    // entities: soft shadow + bob + face + a dark outline. NPCs 24, beasts 22, small fauna (kind 2) 16.
    for (int i = 0; i < NENT; i++) {
        const Ent *e = &R->ent[i];
        int nsx = e->x - cam_x, nsy = e->y - cam_y;
        if (nsx < -24 || nsx > W + 24 || nsy < -24 || nsy > H + 24) continue;
        int nb = e->pause == 0 ? (int)((s_frame >> 3) & 1) : 0;
        int sz = e->kind == 0 ? 24 : (e->kind == 2 ? 16 : 22);
        tile_dither_ellipse(nsx, nsy + sz / 2 - 2, sz / 2 - 1, 3, 0x00);
        tile_blit_sz(T(e->sprite), e->face, nsx, nsy - nb, sz, e->kind == 1 ? TILE_RGB332(96, 0, 0) : 0x00);
    }

    // player: soft shadow + outlined 26 px sprite + walk bob; blink during i-frames
    int bob = s_moving ? (int)((s_frame >> 2) & 1) * 2 : 0;
    int psx = s_px - cam_x, psy = s_py - cam_y;
    tile_dither_ellipse(psx, psy + 11, 11, 4, 0x00);
    if (!(s_hurt > 0 && (s_frame & 4))) tile_blit_sz(T(C_HERO), s_face, psx, psy - bob, 26, TILE_RGB332(255, 255, 255));

    // floating numbers: "+12" gold over an opened chest, "-1" red over a bitten hero, "+N" green when healed
    char b[8];
    for (int i = 0; i < NPOP; i++) {
        const Pop *p = &R->pop[i]; if (!p->t) continue;
        snprintf(b, sizeof b, p->v > 0 ? "+%d" : "%d", p->v);
        gui::text(b, p->x - cam_x, p->y - cam_y, 1, gui::F_BODY, p->gold ? COL_GOLD : p->v < 0 ? 0xF9A6 : COL_ACC, 0x0000);
        if (p->gold && p->t > 30) for (int k = 0; k < 8; k++) {      // a sparkle burst as the lid opens
            static const int8_t U[8][2] = { {10,0},{7,7},{0,10},{-7,7},{-10,0},{-7,-7},{0,-10},{7,-7} };
            int r = (40 - p->t) * 2 + 4;
            d.fillRect(p->x - cam_x + U[k][0] * r / 10, p->y - cam_y + 10 + U[k][1] * r / 10, 2, 2, 0xFFF6);
        }
    }
}

// Spectral overlay for the haunted graveyard: drifting fog scanlines + pale spirits rising. Drawn only
// while the player stands on crypt ground, so the mood is a place, not a permanent filter.
static void haunt_overlay(void)
{
    for (int y = 17 + (int)((s_frame >> 1) % 7); y < H; y += 7)     // slow-drifting cold fog bands (below HUD)
        d.drawFastHLine(0, y, W, 0x28A6);
    for (int i = 0; i < 7; i++) {                                   // rising spirits
        int phase = (int)((s_frame >> 1) + i * 53);
        int sy = H - (phase % (H + 30));
        int sx = (i * 41 + 20) % (W - 20) + 10 + (((phase >> 3) & 7) - 3);
        if (sy > 17 && sy < H) {
            d.fillCircle(sx, sy, 2, 0xBEFF);
            d.drawPixel(sx, sy + 3, 0x6CBF); d.drawPixel(sx, sy + 5, 0x4438);
        }
    }
}

static void draw_play(void)
{
    draw_world();
    char gb = base_at(s_px >> 4, s_py >> 4);
    if (gb == 'g' || gb == 'G') haunt_overlay();       // in the graveyard -> spectral mood
    if (s_hurt > 24) { d.drawRect(0, 0, W, H, 0xF800); d.drawRect(1, 1, W - 2, H - 2, 0xF800); }   // hit flash
    draw_hud();
    if (s_toast_t > 0) {
        int tw = gui::text_width(R->toast, gui::F_SMALL);
        gui::panel(W / 2 - tw / 2 - 8, 20, tw + 16, 19, gui::rgb(0, 0, 0), COL_GOLD);
        gui::text(R->toast, W / 2, 21, 1, gui::F_SMALL, COL_GOLD, 0x0000);
    }
    if (s_dlg >= 0) draw_dialogue();
    else if (s_legend_t > 0 && s_gs == GS_PLAY) {       // the controls, for the first seconds of play
        gui::panel(6, H - 38, W - 14, 34, gui::rgb(0, 0, 0), 0x4208);
        gui::text(GT("Frecce o W/A/I/O: muovi", "Arrows or W/A/I/O: move"), W / 2, H - 36, 1, gui::F_SMALL, 0xFFFF, 0x0000);
        gui::text(GT("INVIO parla/apri   Esc pausa", "ENTER talk/open   Esc pause"), W / 2, H - 20, 1, gui::F_SMALL, COL_GOLD, 0x0000);
    }
}

// title items: Continue (only with a save), New game, Settings
static int menu_items(int *act)
{
    int n = 0;
    if (s_has_save) act[n++] = 0;
    act[n++] = 1;
    act[n++] = 2;
    return n;
}
static void draw_menu(void)
{
    char sub[40];
    snprintf(sub, sizeof sub, GT("Trova i %d scrigni del regno", "Find the kingdom's %d chests"), s_nchest);
    int y = gui::title("Cardler", sub, COL_ACC);
    if (s_atlas_ok) {                                      // the hero and a chest flank the title
        tile_blit_sz(T(C_HERO), 0, 26, 18, 30, 0x00);
        tile_blit_sz(T(C_CHEST), 0, W - 26, 20, 22, 0x00);
    }
    int act[3], n = menu_items(act);
    const char *items[3];
    for (int i = 0; i < n; i++)
        items[i] = act[i] == 0 ? GT("Continua", "Continue") : act[i] == 1 ? GT("Nuova partita", "New game") : GT("Impostazioni", "Settings");
    gui::menu(s_menu, items, n, y, nucleo_app_content_height(), COL_ACC);
}

static void on_draw(void)
{
    if (s_gs == GS_MENU)     { draw_menu(); return; }
    if (s_gs == GS_SETTINGS) { tile_cfg_draw(&s_cfg, s_setm, COL_ACC); return; }
    if (!s_atlas_ok) {                                 // the world needs the atlas: say what is missing
        gui::title("Cardler", nullptr, 0xF9A6);
        gui::dialog(GT("Grafica mancante", "Graphics missing"), ATLAS_PATH, nullptr, GT("Esc menu", "Esc menu"), 0xF9A6);
        return;
    }
    draw_play();
    char b[40];
    if (s_gs == GS_PAUSE)
        gui::dialog(GT("Pausa", "Paused"), nullptr, nullptr, GT("INVIO riprendi   Esc salva ed esci", "ENTER resume   Esc save & quit"), COL_GOLD);
    else if (s_gs == GS_OVER) {
        snprintf(b, sizeof b, GT("Perdi meta' dell'oro: %d", "You lose half your gold: %d"), s_gold - s_gold / 2);
        gui::dialog(GT("Sei svenuto", "You fainted"), GT("Ti risvegli al villaggio", "You wake up in the village"), b,
                    GT("INVIO continua   Esc menu", "ENTER continue   Esc menu"), 0xF9A6);
    } else if (s_gs == GS_WIN) {
        snprintf(b, sizeof b, GT("Tutti i %d scrigni, %d oro", "All %d chests, %d gold"), s_nchest, s_gold);
        gui::dialog(GT("Vittoria!", "Victory!"), b, GT("Il regno e' salvo", "The kingdom is saved"),
                    GT("INVIO esplora   Esc menu", "ENTER explore   Esc menu"), COL_ACC);
    }
}

static bool poll_fn(void)
{
    int64_t now = esp_timer_get_time();
    int dt = s_poll_us ? (int)((now - s_poll_us) / 1000) : 0;
    s_poll_us = now;
    if (s_gs == GS_MENU)     return gui::menu_tick(s_menu, dt);   // a still menu pushes nothing
    if (s_gs == GS_SETTINGS) return gui::menu_tick(s_setm, dt);
    if (s_gs != GS_PLAY || !s_atlas_ok || now - s_last_us < STEP_US) return false;   // pause / cards: on input only
    s_last_us = now;
    s_frame++;
    step();
    return true;
}

static void title_enter(void)
{
    int act[3], n = menu_items(act);
    switch (act[s_menu.sel < n ? s_menu.sel : n - 1]) {
        case 0: if (load_run()) play(); else { s_has_save = false; s_menu.sel = 0; s_menu.pos = 0; nucleo_app_request_draw(); } break;   // unreadable: stay, never overwrite
        case 1: new_run(); save_write(); play(); break;
        default: s_setm.sel = 0; s_setm.pos = 0; go(GS_SETTINGS); break;
    }
}

static bool on_back(int key)
{
    if (key == NK_LEFT) {                               // LEFT: change a setting; in play it is a held movement key
        if (s_gs == GS_SETTINGS) { tile_cfg_adjust(&s_cfg, s_setm.sel, -1); sfx(SFX_SELECT); nucleo_app_request_draw(); }
        return true;
    }
    switch (s_gs) {                                     // Esc
        case GS_MENU:     return false;                 // close the app
        case GS_SETTINGS: tile_cfg_save(&s_cfg, CFG_PATH); go(GS_MENU); return true;
        case GS_PLAY:     if (s_dlg >= 0) { s_dlg = -1; nucleo_app_request_draw(); } else { sfx(SFX_PAUSE); go(GS_PAUSE); } return true;
        default:          leave_play(); return true;   // pause / fainted / victory -> save + title
    }
}

static void on_key(int key, char ch)
{
    switch (s_gs) {
        case GS_MENU: {
            int act[3], n = menu_items(act);
            if (gui::menu_key(s_menu, key, n)) { sfx(SFX_SELECT); break; }
            if (key == NK_ENTER || key == NK_RIGHT) { title_enter(); return; }
            if (ch >= '1' && ch < '1' + n) { s_menu.sel = (int8_t)(ch - '1'); title_enter(); return; }
            break;
        }
        case GS_SETTINGS:
            if (gui::menu_key(s_setm, key, tile_cfg_rows())) { sfx(SFX_SELECT); break; }
            if (key == NK_RIGHT || key == NK_ENTER) { tile_cfg_adjust(&s_cfg, s_setm.sel, +1); sfx(SFX_SELECT); }
            break;
        case GS_PLAY:
            if (key == NK_ENTER && s_atlas_ok) interact();
            break;
        case GS_PAUSE: case GS_WIN:
            if (key == NK_ENTER) go(GS_PLAY);
            break;
        case GS_OVER:                                    // wake at the village with full HP and half the gold
            if (key == NK_ENTER) { s_px = s_start_x; s_py = s_start_y; s_hp = HPMAX; s_gold /= 2; save_write(); play(); }
            break;
    }
    nucleo_app_request_draw();
}

static const nucleo_app_ram_t APP_RAM[] = { { (void **)&R, sizeof(Run) }, { nullptr, 0 } };

extern "C" void nucleo_register_cardler(void)
{
    static const nucleo_app_def_t app = {
        "cardler", "Cardler", "Games", "Mini RPG: esplora, parla, raccogli",
        'C', 0x3FE6,
        on_enter, on_key, nullptr, on_draw, on_exit,
        NX_SOLO, APP_RAM
    };
    nucleo_app_register(&app);
}
